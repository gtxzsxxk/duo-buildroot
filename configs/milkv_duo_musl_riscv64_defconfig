## configs/milkv_duo_musl_riscv64_defconfig
```kconfig
BR2_riscv=y
BR2_riscv_custom=y
BR2_RISCV_ISA_CUSTOM_RVM=y
BR2_RISCV_ISA_CUSTOM_RVA=y
BR2_RISCV_ISA_CUSTOM_RVF=y
BR2_RISCV_ISA_CUSTOM_RVD=y
BR2_RISCV_ISA_CUSTOM_RVC=y
BR2_TOOLCHAIN_BUILDROOT_MUSL=y
BR2_KERNEL_HEADERS_5_10=y
BR2_GCC_VERSION_13_X=y
BR2_TOOLCHAIN_BUILDROOT_CXX=y
BR2_TARGET_LDFLAGS="-march=rv64imafdc_xtheadba_xtheadbb_xtheadbs_xtheadcmo_xtheadcondmov_xtheadfmemidx_xtheadfmv_xtheadint_xtheadmac_xtheadmemidx_xtheadmempair_xtheadsync"
BR2_GLOBAL_PATCH_DIR="board/milkv/duo/patches"
BR2_TARGET_GENERIC_HOSTNAME="milkv-duo"
BR2_TARGET_GENERIC_ISSUE="Welcome to Milk-V"
BR2_INIT_SYSV=y
BR2_TARGET_GENERIC_ROOT_PASSWD="milkv"
BR2_SYSTEM_BIN_SH_BASH=y
BR2_ROOTFS_OVERLAY="board/milkv/duo/overlay"
BR2_ROOTFS_POST_IMAGE_SCRIPT="board/milkv/duo/post-image.sh"
BR2_LINUX_KERNEL=y
BR2_LINUX_KERNEL_CUSTOM_GIT=y
BR2_LINUX_KERNEL_CUSTOM_REPO_URL="https://github.com/T-head-Semi/linux.git"
BR2_LINUX_KERNEL_CUSTOM_REPO_VERSION="b1313fe517ca3703119dcc99ef3bbf75ab42bcfb"
BR2_LINUX_KERNEL_DEFCONFIG="cvitek_cv1800b_milkv_duo_sd"
BR2_LINUX_KERNEL_LZMA=y
BR2_PACKAGE_BZIP2=y
BR2_PACKAGE_GZIP=y
BR2_PACKAGE_LZIP=y
BR2_PACKAGE_UNZIP=y
BR2_PACKAGE_ZIP=y
BR2_PACKAGE_GDB=y
BR2_PACKAGE_GDB_DEBUGGER=y
BR2_PACKAGE_SPIDEV_TEST=y
BR2_PACKAGE_STRACE=y
BR2_PACKAGE_BINUTILS=y
BR2_PACKAGE_GREP=y
BR2_PACKAGE_MAKE=y
BR2_PACKAGE_PATCH=y
BR2_PACKAGE_TREE=y
BR2_PACKAGE_DOSFSTOOLS=y
BR2_PACKAGE_E2FSPROGS=y
BR2_PACKAGE_E2FSPROGS_RESIZE2FS=y
BR2_PACKAGE_MILKV_DUO_FIRMWARE_FSBL=y
BR2_PACKAGE_EVTEST=y
BR2_PACKAGE_PYTHON3=y
BR2_PACKAGE_PYTHON_EVDEV=y
BR2_PACKAGE_PYTHON_LXML=y
BR2_PACKAGE_PYTHON_MODBUS_TK=y
BR2_PACKAGE_PYTHON_PILLOW=y
BR2_PACKAGE_PYTHON_PIP=y
BR2_PACKAGE_PYTHON_SMBUS_CFFI=y
BR2_PACKAGE_PYTHON_SPIDEV=y
BR2_PACKAGE_FREETYPE=y
BR2_PACKAGE_JSON_C=y
BR2_PACKAGE_DHCPCD=y
BR2_PACKAGE_DNSMASQ=y
BR2_PACKAGE_DROPBEAR=y
BR2_PACKAGE_LRZSZ=y
BR2_PACKAGE_NTP=y
BR2_PACKAGE_NTP_NTPDATE=y
BR2_PACKAGE_NTP_NTPTIME=y
BR2_PACKAGE_WPA_SUPPLICANT=y
BR2_PACKAGE_WPA_SUPPLICANT_CLI=y
BR2_PACKAGE_WPA_SUPPLICANT_WPA_CLIENT_SO=y
BR2_PACKAGE_NEOFETCH=y
BR2_PACKAGE_TMUX=y
BR2_PACKAGE_WHICH=y
BR2_PACKAGE_HTOP=y
BR2_PACKAGE_KMOD=y
BR2_PACKAGE_NANO=y
BR2_TARGET_ROOTFS_EXT2=y
BR2_TARGET_ROOTFS_EXT2_4=y
BR2_TARGET_ROOTFS_EXT2_SIZE="200M"
BR2_TARGET_ROOTFS_TAR_XZ=y
BR2_TARGET_OPENSBI=y
BR2_TARGET_OPENSBI_CUSTOM_GIT=y
BR2_TARGET_OPENSBI_CUSTOM_REPO_URL="https://github.com/T-head-Semi/opensbi.git"
BR2_TARGET_OPENSBI_CUSTOM_REPO_VERSION="4e77060e0512ad981eee55d5a2501f6d88a41fd9"
BR2_TARGET_OPENSBI_PLAT="generic"
BR2_TARGET_OPENSBI_UBOOT_PAYLOAD=y
BR2_TARGET_OPENSBI_FW_FDT_PATH=y
BR2_TARGET_UBOOT=y
BR2_TARGET_UBOOT_BUILD_SYSTEM_KCONFIG=y
BR2_TARGET_UBOOT_CUSTOM_GIT=y
BR2_TARGET_UBOOT_CUSTOM_REPO_URL="https://github.com/u-boot/u-boot.git"
BR2_TARGET_UBOOT_CUSTOM_REPO_VERSION="d80bb749fab53da72c4a0e09b8c2d2aaa3103c91"
BR2_TARGET_UBOOT_BOARD_DEFCONFIG="cvitek_cv1800b_milkv_duo_sd"
BR2_TARGET_UBOOT_NEEDS_DTC=y
BR2_TARGET_UBOOT_NEEDS_OPENSBI=y
BR2_PACKAGE_HOST_DOSFSTOOLS=y
BR2_PACKAGE_HOST_GENIMAGE=y
BR2_PACKAGE_HOST_LZMA_ALONE=y
BR2_PACKAGE_HOST_MTOOLS=y
BR2_PACKAGE_HOST_UBOOT_TOOLS=y
BR2_PACKAGE_HOST_UBOOT_TOOLS_FIT_SUPPORT=y
```

## package/milkv-duo-firmware-fsbl/Config.in
```kconfig
config BR2_PACKAGE_MILKV_DUO_FIRMWARE_FSBL
	bool "milkv-duo-firmware-fsbl"
	depends on BR2_riscv
	select BR2_PACKAGE_HOST_MTOOLS
	help
	  This package is obtained from
	  https://github.com/milkv-duo/duo-buildroot-sdk,
	  from which we download the first stage bootloader source and
	  compile it, generating the atf bl2.bin. At the mean time, we
	  will use the fiptool.py in this package to create the binary
	  file fip.bin to pack the opensbi, u-boot and so on.

	  If you are using Buildroot to generate the whole SD card
	  Image or the fip.bin, you must say Y to this package!

	  https://github.com/gtxzsxxk/milkv-duo-firmware-fsbl
```

## package/milkv-duo-pinmux/Config.in
```kconfig
config BR2_PACKAGE_MILKV_DUO_PINMUX
	bool "milkv-duo-pinmux"
	help
	  This package is obtained from
	  https://github.com/milkv-duo/duo-buildroot-sdk
	  from which we download source code of duo-pinmux.
	  This tool can get or set function of any Milk-V Duo
	  GPIO pin. More info at

	  https://milkv.io/docs/duo/application-development/pinmux

	  https://github.com/shodan8192/milkv-duo-pinmux
```
